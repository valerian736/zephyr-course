## boards/espressif/mythrill_s3/board.yml
```yaml
board:
  name: mythrill_s3
  full_name: MYTHRILL_s3
  vendor: espressif
  socs:
  - name: esp32s3
```

## boards/espressif/mythrill_s3_scratch/Kconfig.mythrill_s3_scratch
```kconfig
# Copyright (c) 2024
# SPDX-License-Identifier: Apache-2.0

config BOARD_MYTHRILL_S3_SCRATCH
        select SOC_ESP32S3_WROOM_N8
        select SOC_ESP32S3_PROCPU if BOARD_MYTHRILL_S3_SCRATCH
```

## boards/espressif/mythrill_s3_scratch/board.yml
```yaml
board:
  name: mythrill_s3_scratch
  full_name: Mythrill S3 Scratch
  vendor: espressif
  socs:
  - name: esp32s3
```
